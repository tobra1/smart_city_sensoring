
/*
 * Made by Tobias Brasch, s113618@student.dtu.dk
 * Main file for gprs_sensor_box, which contains the code
 * that will run on the device.
 */


//Libraries
#include <LEEPROM.h>

//Variables used by this file
int version = 1;
String UUID = "";

//Wait times for each sensor
long battery_waitTime = 360000, gps_waitTime = 86400000, dht_waitTime = 360000, multigas_waitTime = 360000, 
  dust_waitTime = 360000, barometer_waitTime = 360000, sound_waitTime = 360000, 
  sunlight_waitTime = 360000, co2_waitTime = 360000;
  
//Last run for each sensor
long battery_lastStep, gps_lastStep, dht_lastStep, multigas_lastStep, dust_lastStep, 
  barometer_lastStep, sound_lastStep, sunlight_lastStep, co2_lastStep;

/*
 * If new unit post the version number to the server and
 * getting the uuid generated by the database and saves it
 * to the EEPROM and the UUID variable. Else it finds the 
 * UUID in the EEPROM and saves to the UUID variable.
 */
void addIdToEEPROM(){
  if(EEPROM.read(1) == 0){
    connectToServer();

    resetJSON();
    addOtherVariable("version", (String) version);
    
    String id = idGenerator();

    char str[id.length()];
    id.toCharArray(str,id.length()+1);
  
    for(int i = 0; i < id.length(); i++){
      EEPROM.write(i, (int)str[i]);
    }
    
    Serial.print("New UUID: ");
    for(int i = 0; i < id.length(); i++){
      UUID += (char)EEPROM.read(i);
    }
    Serial.println(UUID);
    Serial.println();
    disconnectServer();
  }
  else {
    Serial.print("UUID: ");
    for(int i = 0; i < 36; i++){
      UUID += (char)EEPROM.read(i);
    }
    Serial.println(UUID);
    Serial.println();
  }
}

void setup() { 
  Serial.begin(115200);

  for(int i = 0; i < 100; i++){
    EEPROM.write(i, 0);
  }

  Serial.println("Initialising");
  addIdToEEPROM();

  Serial.println("Starts sensors");
  setupDHT();
  setupMultigas();
  setupDust();
  setupBarometer();
  setupSound();
  setupSunlight();
  setupCO2();
  
  Serial.println("Finished initialising");
}

void loop() {
  /* 
   * At the moment a new connection has to be made for each
   * post. This should be looked at so we can get through 
   * the loop faster.
   * 
   * There also is a need for a way to check if the sensor 
   * is connected, so the database won be populated with 
   * readings from sensors not connected to device.
   * This can maybe be done by using the error reading part.
   * 
   */
  String p;
  resetJSON();
  //Check battery status
  Serial.println("Battery");
  p = getBattery();
  Serial.println(p);
  
  
  //Finding location and posting it to server.
  if((millis()-gps_lastStep) > gps_waitTime || isnan(gps_lastStep) || gps_lastStep == 0){
    Serial.println("GPS");
    p = getCurrentPosition();
    Serial.println(p);
    gps_lastStep = millis();
  }

  
  Serial.println("DHT");
  //Finding DHT and posting it to server
  p = getDHT();
  Serial.println(p);
  
  
  Serial.println("Multigas");
  p = multigasReading();
  Serial.println(p);

  //Not part of first version reason lack of space in box
  Serial.println("Dust");
  p = dustReading();
  Serial.println(p);
  
  
  /*Serial.println("Barometer");
  p = barometerReading();
  Serial.println(p); 
  */
  Serial.println("Sound");
  p = soundReading();
  Serial.println(p);  
  
  Serial.println("Sunlight");
  p = sunlightReading();
  Serial.println(p);  
  
  /*Serial.println("CO2");
  p = co2Reading();
  Serial.println(p);
  */
  Serial.println("POST");
  connectToServer();
  post(getJSON(true),"sensorboxall");
  disconnectServer();

  delay(360000);
}

